## Kconfig
```kconfig
config USR_DRV_USART
  bool  "userspace USART library"
  select USR_DRV_USB_FS
  default y
  ---help---
  Support for STM32 USART peripherals in userspace

if USR_DRV_USART

source 'subprojects/merlin/Kconfig'

endif
```
